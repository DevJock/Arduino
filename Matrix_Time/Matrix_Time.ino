#include "LedControl.h"
#include "binary.h"

LedControl lc=LedControl(10,11,12,2);

int numDevices = 2;

int oldData = -1;
int cyclesPerSecond = 979;

//pins
int clockInterrupt = 0; //interrupt 0 is pin 2 on UNO
int pwmOut = 6; //pin 6

//timekeeping
int seconds = 0;
int minutes = 0;
int hours = 0;
int masterClock = 0;//number of square wave


// *CONSTANTS
const byte font5x7 [] = 
{      //Numeric Font Matrix
  B00000000,	//Space (Char 0x20)
  B00000000,
  B00000000,
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  B00000000,
};



void setup()
{
  Serial.begin(9600);
  attachInterrupt(clockInterrupt, clockCounter, RISING);
  delay(2000);
  analogReference(DEFAULT);
  Serial.println(pwmOut);
  analogWrite(pwmOut, 127);
  for(int i =0;i<2;i++)
  {
    lc.shutdown(i,false);
    lc.setIntensity(i,1);
    lc.clearDisplay(i);
  }
}

void loop()
{ 
  if(Serial.available())
  {
    String in = Serial.readStringUntil('\n');
    Serial.print("Received Data: ");
    Serial.println(in);
    setData(in);
  }
  else
  {
    
  }
}

void serialPrintTime()
{
  if(hours<10)
  {
    Serial.print("0");
  }
  Serial.print(hours);
  Serial.print(":");
  if(minutes<10)
  {
    Serial.print("0");
  }
  Serial.print(minutes);
  Serial.print(":");
  if(seconds<10)
  {
    Serial.print("0");
  }
  Serial.println(seconds);
}

void displayTime()
{
  int d = 0;
  d = hours * 100 + minutes;
}

void setData(String input)
{
  hours = input.substring(0,2).toInt();
  minutes = input.substring(2,4).toInt();
  seconds = input.substring(4,6).toInt();
}

void clockCounter()
{
  masterClock ++;
  if(masterClock == cyclesPerSecond)
  {
    seconds ++; 
    masterClock = 0; 
    if(seconds==60)
    {
      minutes++;
      seconds = 0;//reset seconds counter
      if(minutes==60)
      {
        hours++;
        minutes = 0;
      }
    }
  serialPrintTime();
  displayTime();
  }
  return;
}



